/*
 * SSD1306.c
 *
 * Created: 13.06.2021 8:59:41
 *  Author: Dubishkin
 *
 * useful dymbol generator (not mine): http://dotmatrixtool.com
 */ 
  
#include "settings.h"

#include <avr/io.h>
#include <util/delay.h>
#include <avr/pgmspace.h>
#include <stdint.h>
#include <string.h>
#include "I2C.h"
#include "SSD1306.h"

static uint8_t oled_buf[1] = {0};
//uint8_t oled_frame[OLED_H/8][OLED_W] = {0};


const char font_px8[160][5] PROGMEM = {
	{ 0x00, 0x00, 0x00, 0x00, 0x00 },	// (sp) 0x20
	{ 0x00, 0x00, 0x5F, 0x00, 0x00 },	// !	0x21
	{ 0x00, 0x07, 0x00, 0x07, 0x00 },	// "	0x22
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	{ 0x08, 0x54, 0x34, 0x14, 0x7c } 	//я		0xBF
};

static void SSD1306_send_CMD(uint8_t cmd1) {
	oled_buf[0] = cmd1;
	I2C_write(SSD1306_ADDR, 0x00, oled_buf, 1);
}

uint8_t OLED_init() {
	_delay_ms(10);

	// Init sequence
	SSD1306_send_CMD(SSD1306_DISPLAYOFF);			//0xAE - Set Display OFF

	SSD1306_send_CMD(SSD1306_SETDISPLAYCLOCKDIV);	//0xD5 - Set Display Clock Divide Ratio/ Oscillator Frequency
	SSD1306_send_CMD(0x80);							// the suggested ratio 0x80

	SSD1306_send_CMD(SSD1306_SETMULTIPLEX);			//0xA8 - Set Multiplex Ratio
	SSD1306_send_CMD(OLED_H - 1);

	SSD1306_send_CMD(SSD1306_SETDISPLAYOFFSET);		//0xD3 - Set Display Offset
	SSD1306_send_CMD(0x00);							//no offset

	SSD1306_send_CMD(SSD1306_SETSTARTLINE + 0);		// line #0

	SSD1306_send_CMD(SSD1306_CHARGEPUMP);			//0x8D - Charge Pump Setting
	SSD1306_send_CMD(0x14);							//Enable Charge Pump

	SSD1306_send_CMD(SSD1306_MEMORYMODE);			//0x20 - Set Memory Addressing
	SSD1306_send_CMD(0x00);							//0x0 act like ks0108

	SSD1306_send_CMD(SSD1306_SEGREMAP | 0x1);
	#ifndef OLED_ROTATE_180
	SSD1306_send_CMD(SSD1306_COMSCANDEC);
	#else
	SSD1306_send_CMD(SSD1306_COMSCANINC);
	#endif

	/*#if defined SSD1306_128_32
	ssd1306_command(SSD1306_SETCOMPINS);                    // 0xDA
	ssd1306_command(0x02);
	ssd1306_command(SSD1306_SETCONTRAST);                   // 0x81
	ssd1306_command(0x8F);
	#elif defined SSD1306_128_64 */
	SSD1306_send_CMD(SSD1306_SETCOMPINS);			//0xDA - Set COM Pins Hardware Configuration
	SSD1306_send_CMD(0x12);

	SSD1306_send_CMD(SSD1306_SETCONTRAST);			//0x81 - Set Contrast
	SSD1306_send_CMD(0x0F);
	
	/*#elif defined SSD1306_96_16
	ssd1306_command(SSD1306_SETCOMPINS);                    // 0xDA
	ssd1306_command(0x2);   //ada x12
	ssd1306_command(SSD1306_SETCONTRAST);                   // 0x81
	if (vccstate == SSD1306_EXTERNALVCC)
	{ ssd1306_command(0x10); }
	else
	{ ssd1306_command(0xAF); }
	#endif*/

	SSD1306_send_CMD(SSD1306_SETPRECHARGE);			//0xD9 - Set Pre-charge Period
	SSD1306_send_CMD(0xF1);

	SSD1306_send_CMD(SSD1306_SETVCOMDETECT);		//0xDB -  Set Vcomh Deselect Level
	SSD1306_send_CMD(0x40);

	SSD1306_send_CMD(SSD1306_DISPLAYALLON_RESUME);	//0xA4 - Entire Display ON
	SSD1306_send_CMD(SSD1306_NORMALDISPLAY);		//0xA6 - Set Normal Display

	SSD1306_send_CMD(SSD1306_DEACTIVATE_SCROLL);

	SSD1306_send_CMD(SSD1306_DISPLAYON); 
	
	return 0;
}

void OLED_displayOn() {
	SSD1306_send_CMD(SSD1306_DISPLAYON);
}

void OLED_displayOff() {
	SSD1306_send_CMD(SSD1306_DISPLAYOFF);
}

/*void OLED_showBuf() {
	SSD1306_send_CMD(SSD1306_COLUMNADDR);
	SSD1306_send_CMD(0);   // Column start address (0 = reset)
	SSD1306_send_CMD(OLED_W-1); // Column end address (127 = reset)

	SSD1306_send_CMD(SSD1306_PAGEADDR);
	SSD1306_send_CMD(0); // Page start address (0 = reset)

	#if OLED_H == 64
	SSD1306_send_CMD(7); // Page end address
	#elif OLED_H == 32
	SSD1306_send_CMD(3); // Page end address
	#elif OLED_H == 16
	SSD1306_send_CMD(1); // Page end address
	#endif

	
	#ifdef OLED_ROTATE_180
	uint8_t temp;
	for (uint8_t page = 0; page < (OLED_H/8); page++) {
		for (uint8_t i = 0; i < OLED_W/2; i++) {
			temp = oled_frame[page][i];
			oled_frame[page][i] = oled_frame[page][OLED_W - 1 - i];
			oled_frame[page][OLED_W - 1 - i] = temp;
		}
	}
	#endif
	
	for (uint8_t page = 0; page < OLED_H/8; page++) {
		I2C_write(SSD1306_ADDR, 0x40, oled_frame[page], OLED_W);
	}
	
	*#ifdef OLED_ROTATE_180
	for (uint8_t page = 0; page < (OLED_H/8); page++) {
		for (uint8_t i = 0; i < OLED_W/2; i++) {
			temp = oled_frame[page][i];
			oled_frame[page][i] = oled_frame[page][OLED_W - 1 - i];
			oled_frame[page][OLED_W - 1 - i] = temp;
		}
	}
	#endif*
}*/

void OLED_fill(uint8_t color) {
	if(color) color = 0xFF;

	SSD1306_send_CMD(SSD1306_COLUMNADDR);
	SSD1306_send_CMD(0);   // Column start address (0 = reset)
	SSD1306_send_CMD(OLED_W-1); // Column end address (127 = reset)

	SSD1306_send_CMD(SSD1306_PAGEADDR);
	SSD1306_send_CMD(0); // Page start address (0 = reset)

	#if OLED_H == 64
	SSD1306_send_CMD(7); // Page end address
	#elif OLED_H == 32
	SSD1306_send_CMD(3); // Page end address
	#elif OLED_H == 16
	SSD1306_send_CMD(1); // Page end address
	#endif

	uint8_t row[OLED_W];
	memset(row, color, OLED_W);

	for (uint8_t page = 0; page < OLED_H/8; page++) {
		I2C_write(SSD1306_ADDR, 0x40, row, OLED_W);
	}
}

void OLED_writeRow(uint8_t y, uint8_t x_start, uint8_t x_end, uint8_t * data) {
	if(y > OLED_H/8-1) y = OLED_H/8-1;
	if(x_start > OLED_W-1) x_start = OLED_W-1;
	if(x_end > OLED_W-1) x_end = OLED_W-1;
	
	#ifndef OLED_ROTATE_180	
	SSD1306_send_CMD(SSD1306_COLUMNADDR);
	SSD1306_send_CMD(x_start);   // Column start address (0 = reset)
	SSD1306_send_CMD(x_end); // Column end address (127 = reset)
	#else
	uint8_t temp;
	for (uint8_t i = 0; i < (x_end-x_start)/2; i++) {
		temp = *(data + i);
		*(data + i) = *(data + x_end-x_start - 1 - i);
		*(data + x_end-x_start - 1 - i) = temp;
	}
	SSD1306_send_CMD(SSD1306_COLUMNADDR);
	SSD1306_send_CMD(OLED_W - x_end - 1);   // Column start address (0 = reset)
	SSD1306_send_CMD(OLED_W - x_start - 1); // Column end address (127 = reset)
	#endif
	

	SSD1306_send_CMD(SSD1306_PAGEADDR);
	SSD1306_send_CMD(y); // Page start address (0 = reset)
	SSD1306_send_CMD(y+1); // Page end address

	I2C_write(SSD1306_ADDR, 0x40, (uint8_t *) data, x_end-x_start+1);
}

void OLED_printString(uint8_t x, uint8_t y, uint8_t font, char * data) {
	y /= 8;

	uint8_t row[OLED_W] = { 0 };
	uint8_t c;
	uint8_t x_end = 0;
	/*if (font <= 1) {
		while ((c = *data++)) {
			if (c >= 192) c -= 64;
			for (uint8_t s = 0; s < 5; s++) {
				row[x_end] = pgm_read_byte(&(font_px8[c - 0x20][s]));
				x_end++;
			}
			x_end++;
		}
		x_end += x;
		OLED_writeRow(y, x, x_end, row);
		return;
	}*/
	for (uint8_t i = 0; i < font; i++) {						//Цикл по страницам экрана
		memset(row, 0x00, OLED_W);
		x_end = 0;
		for (uint8_t j = 0; (c = *(data + j)); j++) {			//Цикл по символам строки
			if (c >= 192) c -= 64;											//Для русских символов
			uint8_t rows = ((8 % font) == 0) ? (8 / font) : (8 / font + 1);	//Сколько пикселей символа помещается на страницу экрана
			for (uint8_t s = 0; s < 5; s++) {					//Цикл по столбцам символа
				uint8_t col = pgm_read_byte(&(font_px8[c - 0x20][s]));	//Столбец символа
				//uint8_t col = font_px8[c - 0x20][s];						//Столбец символа
				uint8_t part = 0;
				for (uint8_t r = 0; r < rows; r++) {			//Цикл по строкам шрифта внутри страницы
					uint8_t bit = i * 8 / font + r;
					int8_t shift = r * font - (8*i % font);
					if (shift < 0) shift = 0;
					uint8_t mask = 0xFF << shift;
					if ((col & (1 << bit))) part |= mask;
					else part &= ~mask;
				}
				memset(row + x_end, part, font);
				x_end += font;
			}
			x_end ++;
		}
		
		x_end += x;
		OLED_writeRow(y + i, x, x_end, row);
	}
}